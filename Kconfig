## arch/cortex-m23/m2351/src/numaker_pfm_m2351/Kconfig
```kconfig
#
# For a description of the syntax of this configuration file,
# see the file kconfig-language.txt in the docs folder of mTower repository.
#

menu "Secure Attribution Configuration"

menu "GPIO Secure Attribution Configuration"

choice
	prompt "Port A secure configuration"
	default GPIO_SECURE_PA

config GPIO_NONSECURE_PA
	bool "PA non-secure"
	---help---
		GPIO PA is non-secure.

config GPIO_SECURE_PA
	bool "PA secure"
	---help---
		GPIO PA is secure.
endchoice

choice
	prompt "Port B secure configuration"
	default GPIO_SECURE_PB

config GPIO_NONSECURE_PB
	bool "PB non-secure"
	---help---
		GPIO PB is non-secure.

config GPIO_SECURE_PB
	bool "PB secure"
	---help---
		GPIO PB is secure.
endchoice

choice
	prompt "Port C secure configuration"
	default GPIO_SECURE_PC

config GPIO_NONSECURE_PC
	bool "PC non-secure"
	---help---
		GPIO PC is non-secure.

config GPIO_SECURE_PC
	bool "PC secure"
	---help---
		GPIO PC is secure.
endchoice

choice
	prompt "Port D secure configuration"
	default GPIO_SECURE_PD

config GPIO_NONSECURE_PD
	bool "PD non-secure"
	---help---
		GPIO PD is non-secure.

config GPIO_SECURE_PD
	bool "PD secure"
	---help---
		GPIO PD is secure.
endchoice

choice
	prompt "Port E secure configuration"
	default GPIO_SECURE_PE

config GPIO_NONSECURE_PE
	bool "PE non-secure"
	---help---
		GPIO PE is non-secure.

config GPIO_SECURE_PE
	bool "PE secure"
	---help---
		GPIO PE is secure.
endchoice

choice
	prompt "Port F secure configuration"
	default GPIO_SECURE_PF

config GPIO_NONSECURE_PF
	bool "PF non-secure"
	---help---
		GPIO PF is non-secure.

config GPIO_SECURE_PF
	bool "PF secure"
	---help---
		GPIO PF is secure.
endchoice

choice
	prompt "Port G secure configuration"
	default GPIO_SECURE_PG

config GPIO_NONSECURE_PG
	bool "PG non-secure"
	---help---
		GPIO PG is non-secure.

config GPIO_SECURE_PG
	bool "PG secure"
	---help---
		GPIO PG is secure.
endchoice

choice
	prompt "Port H secure configuration"
	default GPIO_SECURE_PH

config GPIO_NONSECURE_PH
	bool "PH non-secure"
	---help---
		GPIO PH is non-secure.

config GPIO_SECURE_PH
	bool "PH secure"
	---help---
		GPIO PH is secure.
endchoice

endmenu # GPIO Secure Attribution Configuration

choice
	prompt "Secure SRAM size"
	default GPIO_SECURE_PH

config SCU_SECURE_SRAM_0
	bool "Secure SRAM 0KB"
config SCU_SECURE_SRAM_8
	bool "Secure SRAM 8KB"
config SCU_SECURE_SRAM_16
	bool "Secure SRAM 16KB"
config SCU_SECURE_SRAM_24
	bool "Secure SRAM 24KB"
config SCU_SECURE_SRAM_32
	bool "Secure SRAM 32KB"
config SCU_SECURE_SRAM_40
	bool "Secure SRAM 40KB"
config SCU_SECURE_SRAM_48
	bool "Secure SRAM 48KB"
config SCU_SECURE_SRAM_56
	bool "Secure SRAM 56KB"
config SCU_SECURE_SRAM_64
	bool "Secure SRAM 64KB"
config SCU_SECURE_SRAM_72
	bool "Secure SRAM 72KB"
config SCU_SECURE_SRAM_80
	bool "Secure SRAM 80KB"
config SCU_SECURE_SRAM_88
	bool "Secure SRAM 88KB"
config SCU_SECURE_SRAM_96
	bool "Secure SRAM 96KB"
endchoice

config SCU_SECURE_SRAM_SIZE
	hex
	default 0x0000   if SCU_SECURE_SRAM_0
	default 0x2000   if SCU_SECURE_SRAM_8
	default 0x4000   if SCU_SECURE_SRAM_16
	default 0x6000   if SCU_SECURE_SRAM_24
	default 0x8000   if SCU_SECURE_SRAM_32
	default 0xA000   if SCU_SECURE_SRAM_40
	default 0xC000   if SCU_SECURE_SRAM_48
	default 0xC000   if SCU_SECURE_SRAM_56
	default 0x10000   if SCU_SECURE_SRAM_64
	default 0x12000   if SCU_SECURE_SRAM_72
	default 0x14000   if SCU_SECURE_SRAM_80
	default 0x16000   if SCU_SECURE_SRAM_88
	default 0x18000   if SCU_SECURE_SRAM_96

config FMC_SECURE_ROM_SIZE
	hex "Secure Flash ROM Size"
	default	0x40000
	range 0x1000 0x40000
	---help---
		"Secure Flash ROM Size."

menu "Peripheral Secure Attribution Configuration"

choice
	prompt "USBH secure configuration"
	default USBH_SECURE

config USBH_NONSECURE
	bool "USBH non-secure"
	---help---
		USBH is non-secure.

config USBH_SECURE
	bool "USBH secure"
	---help---
		USBH is secure.
endchoice

choice
	prompt "SDO secure configuration"
	default SDO_SECURE

config SDO_NONSECURE
	bool "SDO non-secure"
	---help---
		SDO is non-secure.

config SDO_SECURE
	bool "SDO secure"
	---help---
		SDO is secure.
endchoice

choice
	prompt "EBI secure configuration"
	default EBI_SECURE

config EBI_NONSECURE
	bool "EBI non-secure"
	---help---
		EBI is non-secure.

config EBI_SECURE
	bool "EBI secure"
	---help---
		EBI is secure.
endchoice

choice
	prompt "PDMA1 secure configuration"
	default PDMA1_SECURE

config PDMA1_NONSECURE
	bool "PDMA1 non-secure"
	---help---
		PDMA1 is non-secure.

config PDMA1_SECURE
	bool "PDMA1 secure"
	---help---
		PDMA1 is secure.
endchoice

choice
	prompt "CRC secure configuration"
	default CRC_SECURE

config CRC_NONSECURE
	bool "CRC non-secure"
	---help---
		CRC is non-secure.

config CRC_SECURE
	bool "CRC secure"
	---help---
		CRC is secure.
endchoice

choice
	prompt "CRPT secure configuration"
	default CRPT_SECURE

config CRPT_NONSECURE
	bool "CRPT non-secure"
	---help---
		CRPT is non-secure.

config CRPT_SECURE
	bool "CRPT secure"
	---help---
		CRPT is secure.
endchoice

choice
	prompt "RTC secure configuration"
	default RTC_SECURE

config RTC_NONSECURE
	bool "RTC non-secure"
	---help---
		RTC is non-secure.

config RTC_SECURE
	bool "RTC secure"
	---help---
		RTC is secure.
endchoice

choice
	prompt "EADC secure configuration"
	default EADC_SECURE

config EADC_NONSECURE
	bool "EADC non-secure"
	---help---
		EADC is non-secure.

config EADC_SECURE
	bool "EADC secure"
	---help---
		EADC is secure.
endchoice

choice
	prompt "ACMP01 secure configuration"
	default ACMP01_SECURE

config ACMP01_NONSECURE
	bool "ACMP01 non-secure"
	---help---
		ACMP01 is non-secure.

config ACMP01_SECURE
	bool "ACMP01 secure"
	---help---
		ACMP01 is secure.
endchoice

choice
	prompt "DAC secure configuration"
	default DAC_SECURE

config DAC_NONSECURE
	bool "DAC non-secure"
	---help---
		DAC is non-secure.

config DAC_SECURE
	bool "DAC secure"
	---help---
		DAC is secure.
endchoice

choice
	prompt "I2S0 secure configuration"
	default I2S0_SECURE

config I2S0_NONSECURE
	bool "I2S0 non-secure"
	---help---
		I2S0 is non-secure.

config I2S0_SECURE
	bool "I2S0 secure"
	---help---
		I2S0 is secure.
endchoice

choice
	prompt "OTG secure configuration"
	default OTG_SECURE

config OTG_NONSECURE
	bool "OTG non-secure"
	---help---
		OTG is non-secure.

config OTG_SECURE
	bool "OTG secure"
	---help---
		OTG is secure.
endchoice

choice
	prompt "TMR23 secure configuration"
	default TMR23_SECURE

config TMR23_NONSECURE
	bool "TMR23 non-secure"
	---help---
		TMR23 is non-secure.

config TMR23_SECURE
	bool "TMR23 secure"
	---help---
		TMR23 is secure.
endchoice

choice
	prompt "EPWM0 secure configuration"
	default EPWM0_SECURE

config EPWM0_NONSECURE
	bool "EPWM0 non-secure"
	---help---
		EPWM0 is non-secure.

config EPWM0_SECURE
	bool "EPWM0 secure"
	---help---
		EPWM0 is secure.
endchoice

choice
	prompt "EPWM1 secure configuration"
	default EPWM1_SECURE

config EPWM1_NONSECURE
	bool "EPWM1 non-secure"
	---help---
		EPWM1 is non-secure.

config EPWM1_SECURE
	bool "EPWM1 secure"
	---help---
		EPWM1 is secure.
endchoice

choice
	prompt "BPWM0 secure configuration"
	default BPWM0_SECURE

config BPWM0_NONSECURE
	bool "BPWM0 non-secure"
	---help---
		BPWM0 is non-secure.

config BPWM0_SECURE
	bool "BPWM0 secure"
	---help---
		BPWM0 is secure.
endchoice

choice
	prompt "BPWM1 secure configuration"
	default BPWM1_SECURE

config BPWM1_NONSECURE
	bool "BPWM1 non-secure"
	---help---
		BPWM1 is non-secure.

config BPWM1_SECURE
	bool "BPWM1 secure"
	---help---
		BPWM1 is secure.
endchoice

choice
	prompt "QSPI0 secure configuration"
	default QSPI0_SECURE

config QSPI0_NONSECURE
	bool "QSPI0 non-secure"
	---help---
		QSPI0 is non-secure.

config QSPI0_SECURE
	bool "QSPI0 secure"
	---help---
		QSPI0 is secure.
endchoice

choice
	prompt "SPI0 secure configuration"
	default SPI0_SECURE

config SPI0_NONSECURE
	bool "SPI0 non-secure"
	---help---
		SPI0 is non-secure.

config SPI0_SECURE
	bool "SPI0 secure"
	---help---
		SPI0 is secure.
endchoice

choice
	prompt "SPI1 secure configuration"
	default SPI1_SECURE

config SPI1_NONSECURE
	bool "SPI1 non-secure"
	---help---
		SPI1 is non-secure.

config SPI1_SECURE
	bool "SPI1 secure"
	---help---
		SPI1 is secure.
endchoice

choice
	prompt "SPI2 secure configuration"
	default SPI2_SECURE

config SPI2_NONSECURE
	bool "SPI2 non-secure"
	---help---
		SPI2 is non-secure.

config SPI2_SECURE
	bool "SPI2 secure"
	---help---
		SPI2 is secure.
endchoice

choice
	prompt "SPI3 secure configuration"
	default SPI3_SECURE

config SPI3_NONSECURE
	bool "SPI3 non-secure"
	---help---
		SPI3 is non-secure.

config SPI3_SECURE
	bool "SPI3 secure"
	---help---
		SPI3 is secure.
endchoice

choice
	prompt "UART0 secure configuration"
	default UART0_SECURE

config UART0_NONSECURE
	bool "UART0 non-secure"
	---help---
		UART0 is non-secure.

config UART0_SECURE
	bool "UART0 secure"
	---help---
		UART0 is secure.
endchoice

choice
	prompt "UART1 secure configuration"
	default UART1_SECURE

config UART1_NONSECURE
	bool "UART1 non-secure"
	---help---
		UART1 is non-secure.

config UART1_SECURE
	bool "UART1 secure"
	---help---
		UART1 is secure.
endchoice

choice
	prompt "UART2 secure configuration"
	default UART2_SECURE

config UART2_NONSECURE
	bool "UART2 non-secure"
	---help---
		UART2 is non-secure.

config UART2_SECURE
	bool "UART2 secure"
	---help---
		UART2 is secure.
endchoice

choice
	prompt "UART3 secure configuration"
	default UART3_SECURE

config UART3_NONSECURE
	bool "UART3 non-secure"
	---help---
		UART3 is non-secure.

config UART3_SECURE
	bool "UART3 secure"
	---help---
		UART3 is secure.
endchoice

choice
	prompt "UART4 secure configuration"
	default UART4_SECURE

config UART4_NONSECURE
	bool "UART4 non-secure"
	---help---
		UART4 is non-secure.

config UART4_SECURE
	bool "UART4 secure"
	---help---
		UART4 is secure.
endchoice

choice
	prompt "UART5 secure configuration"
	default UART5_SECURE

config UART5_NONSECURE
	bool "UART5 non-secure"
	---help---
		UART5 is non-secure.

config UART5_SECURE
	bool "UART5 secure"
	---help---
		UART5 is secure.
endchoice

choice
	prompt "I2C0 secure configuration"
	default I2C0_SECURE

config I2C0_NONSECURE
	bool "I2C0 non-secure"
	---help---
		I2C0 is non-secure.

config I2C0_SECURE
	bool "I2C0 secure"
	---help---
		I2C0 is secure.
endchoice

choice
	prompt "I2C1 secure configuration"
	default I2C1_SECURE

config I2C1_NONSECURE
	bool "I2C1 non-secure"
	---help---
		I2C1 is non-secure.

config I2C1_SECURE
	bool "I2C1 secure"
	---help---
		I2C1 is secure.
endchoice

choice
	prompt "I2C2 secure configuration"
	default I2C2_SECURE

config I2C2_NONSECURE
	bool "I2C2 non-secure"
	---help---
		I2C2 is non-secure.

config I2C2_SECURE
	bool "I2C2 secure"
	---help---
		I2C2 is secure.
endchoice

choice
	prompt "SC0 secure configuration"
	default SC0_SECURE

config SC0_NONSECURE
	bool "SC0 non-secure"
	---help---
		SC0 is non-secure.

config SC0_SECURE
	bool "SC0 secure"
	---help---
		SC0 is secure.
endchoice

choice
	prompt "SC1 secure configuration"
	default SC1_SECURE

config SC1_NONSECURE
	bool "SC1 non-secure"
	---help---
		SC1 is non-secure.

config SC1_SECURE
	bool "SC1 secure"
	---help---
		SC1 is secure.
endchoice

choice
	prompt "SC2 secure configuration"
	default SC2_SECURE

config SC2_NONSECURE
	bool "SC2 non-secure"
	---help---
		SC2 is non-secure.

config SC2_SECURE
	bool "SC2 secure"
	---help---
		SC2 is secure.
endchoice

choice
	prompt "CAN0 secure configuration"
	default CAN0_SECURE

config CAN0_NONSECURE
	bool "CAN0 non-secure"
	---help---
		CAN0 is non-secure.

config CAN0_SECURE
	bool "CAN0 secure"
	---help---
		CAN0 is secure.
endchoice

choice
	prompt "QEI0 secure configuration"
	default QEI0_SECURE

config QEI0_NONSECURE
	bool "QEI0 non-secure"
	---help---
		QEI0 is non-secure.

config QEI0_SECURE
	bool "QEI0 secure"
	---help---
		QEI0 is secure.
endchoice

choice
	prompt "QEI1 secure configuration"
	default QEI1_SECURE

config QEI1_NONSECURE
	bool "QEI1 non-secure"
	---help---
		QEI1 is non-secure.

config QEI1_SECURE
	bool "QEI1 secure"
	---help---
		QEI1 is secure.
endchoice

choice
	prompt "ECAP0 secure configuration"
	default ECAP0_SECURE

config ECAP0_NONSECURE
	bool "ECAP0 non-secure"
	---help---
		ECAP0 is non-secure.

config ECAP0_SECURE
	bool "ECAP0 secure"
	---help---
		ECAP0 is secure.
endchoice

choice
	prompt "ECAP1 secure configuration"
	default ECAP1_SECURE

config ECAP1_NONSECURE
	bool "ECAP1 non-secure"
	---help---
		ECAP1 is non-secure.

config ECAP1_SECURE
	bool "ECAP1 secure"
	---help---
		ECAP1 is secure.
endchoice

choice
	prompt "TRNG secure configuration"
	default TRNG_SECURE

config TRNG_NONSECURE
	bool "TRNG non-secure"
	---help---
		TRNG is non-secure.

config TRNG_SECURE
	bool "TRNG secure"
	---help---
		TRNG is secure.
endchoice

choice
	prompt "USBD secure configuration"
	default USBD_SECURE

config USBD_NONSECURE
	bool "USBD non-secure"
	---help---
		USBD is non-secure.

config USBD_SECURE
	bool "USBD secure"
	---help---
		USBD is secure.
endchoice

choice
	prompt "USCI0 secure configuration"
	default USCI0_SECURE

config USCI0_NONSECURE
	bool "USCI0 non-secure"
	---help---
		USCI0 is non-secure.

config USCI0_SECURE
	bool "USCI0 secure"
	---help---
		USCI0 is secure.
endchoice

choice
	prompt "USCI1 secure configuration"
	default USCI1_SECURE

config USCI1_NONSECURE
	bool "USCI1 non-secure"
	---help---
		USCI1 is non-secure.

config USCI1_SECURE
	bool "USCI1 secure"
	---help---
		USCI1 is secure.
endchoice

endmenu # Peripheral Secure Attribution Configuration

menu "Enable secure violation interrupts"

config APB0IEN_SECURE_VIOLATION_INTERRUPT
	bool "APB0 secure violation interrupt enable"
	default n
	---help---
		APB0 secure violation interrupt enable.

config APB1IEN_SECURE_VIOLATION_INTERRUPT
	bool "APB1 secure violation interrupt enable"
	default n
	---help---
		APB1 secure violation interrupt enable.

config GPIOIEN_SECURE_VIOLATION_INTERRUPT
	bool "GPIO secure violation interrupt enable"
	default n
	---help---
		GPIO secure violation interrupt enable.

config EBIIEN_SECURE_VIOLATION_INTERRUPT
	bool "EBI secure violation interrupt enable"
	default n
	---help---
		EBI secure violation interrupt enable.

config USBHIEN_SECURE_VIOLATION_INTERRUPT
	bool "USBH secure violation interrupt enable"
	default n
	---help---
		USBH secure violation interrupt enable.

config CRCIEN_SECURE_VIOLATION_INTERRUPT
	bool "CRC secure violation interrupt enable"
	default n
	---help---
		CRC secure violation interrupt enable.

config SDH0IEN_SECURE_VIOLATION_INTERRUPT
	bool "SDH0 secure violation interrupt enable"
	default n
	---help---
		SDH0 secure violation interrupt enable.

config PDMA0IEN_SECURE_VIOLATION_INTERRUPT
	bool "PDMA0 secure violation interrupt enable"
	default n
	---help---
		PDMA0 secure violation interrupt enable.

config PDMA1IEN_SECURE_VIOLATION_INTERRUPT
	bool "PDMA1 secure violation interrupt enable"
	default n
	---help---
		PDMA1 secure violation interrupt enable.

config SRAM0IEN_SECURE_VIOLATION_INTERRUPT
	bool "SRAM0 secure violation interrupt enable"
	default n
	---help---
		SRAM0 secure violation interrupt enable.

config SRAM1IEN_SECURE_VIOLATION_INTERRUPT
	bool "SRAM1 secure violation interrupt enable"
	default n
	---help---
		SRAM1 secure violation interrupt enable.

config FMCIEN_SECURE_VIOLATION_INTERRUPT
	bool "FMC secure violation interrupt enable"
	default n
	---help---
		FMC secure violation interrupt enable.

config FLASHIEN_SECURE_VIOLATION_INTERRUPT
	bool "FLASH secure violation interrupt enable"
	default n
	---help---
		FLASH secure violation interrupt enable.

config SCUIEN_SECURE_VIOLATION_INTERRUPT
	bool "SCU secure violation interrupt enable"
	default n
	---help---
		SCU secure violation interrupt enable.

config SYSIEN_SECURE_VIOLATION_INTERRUPT
	bool "SYS secure violation interrupt enable"
	default n
	---help---
		SYS secure violation interrupt enable.

config CRPTIEN_SECURE_VIOLATION_INTERRUPT
	bool "CRPT secure violation interrupt enable"
	default n
	---help---
		CRPT secure violation interrupt enable.

endmenu # Enable sercure violation interrupts

config SAU_CONTROL
	bool "Secure Attribute Unit (SAU) Control"
	default y
	---help---
		 "Secure Attribute Unit (SAU) Control".

config ENABLE_SAU
	bool "Enable SAU"
	depends on SAU_CONTROL
	default y
	---help---
		 "Enable SAU".

choice
	prompt "All Memory Attribute When SAU is disabled"
	depends on SAU_CONTROL
	default ALL_MEMORY_SECURE

config ALL_MEMORY_NONSECURE
	bool "All Memory non-secure"
	---help---
		All Memory  is non-secure.

config ALL_MEMORY_SECURE
	bool "All Memory secure"
	---help---
		All Memory is secure.
endchoice

menu "Enable and Set Secure/Non-Secure region"

config SAU_INIT_REGION0
	bool "Setup SAU Region 0"
	default y
	---help---
		Setup SAU Region 0.

config SAU_INIT_START0
	hex "Start address of SAU region 0"
	depends on SAU_INIT_REGION0
	default	0x20000000
	---help---
		"Start address of SAU region 0."

config SAU_INIT_END0
	hex "End address of SAU region 0"
	depends on SAU_INIT_REGION0
	default	0x20008000
	---help---
		"End address of SAU region 0."

choice
	prompt "Region 0 secure configuration"
	depends on SAU_INIT_REGION0
	default REGION0_SECURE

config REGION0_NONSECURE
	bool "Region 0 non-secure"
	---help---
		Region 0 is non-secure.

config REGION0_SECURE
	bool "Region 0 secure"
	---help---
		Region 0 is secure.
endchoice

config SAU_INIT_REGION1
	bool "Setup SAU Region 1"
	default n
	---help---
		Setup SAU Region 1.

config SAU_INIT_START1
	hex "Start address of SAU region 1"
	depends on SAU_INIT_REGION1
	default	0x10040000
	---help---
		"Start address of SAU region 1."

config SAU_INIT_END1
	hex "End address of SAU region 1"
	depends on SAU_INIT_REGION1
	default	0x1007FFFF
	---help---
		"End address of SAU region 1."

choice
	prompt "Region 1 secure configuration"
	depends on SAU_INIT_REGION1
	default REGION1_NONSECURE

config REGION1_NONSECURE
	bool "Region 1 non-secure"
	---help---
		Region 1 is non-secure.

config REGION1_SECURE
	bool "Region 1 secure"
	---help---
		Region 1 is secure.
endchoice

config SAU_INIT_REGION2
	bool "Setup SAU Region 2"
	default n
	---help---
		Setup SAU Region 2.

config SAU_INIT_START2
	hex "Start address of SAU region 2"
	depends on SAU_INIT_REGION2
	default	0x2000F000
	---help---
		"Start address of SAU region 2."

config SAU_INIT_END2
	hex "End address of SAU region 2"
	depends on SAU_INIT_REGION2
	default	0x2000FFFF
	---help---
		"End address of SAU region 2."

choice
	prompt "Region 2 secure configuration"
	depends on SAU_INIT_REGION2
	default REGION2_SECURE

config REGION2_NONSECURE
	bool "Region 2 non-secure"
	---help---
		Region 2 is non-secure.

config REGION2_SECURE
	bool "Region 2 secure"
	---help---
		Region 2 is secure.
endchoice

config SAU_INIT_REGION3
	bool "Setup SAU Region 3"
	default y
	---help---
		Setup SAU Region 3.

config SAU_INIT_START3
	hex "Start address of SAU region 3"
	depends on SAU_INIT_REGION3
	default	0x0003F000
	---help---
		"Start address of SAU region 3."

config SAU_INIT_END3
	hex "End address of SAU region 3"
	depends on SAU_INIT_REGION3
	default	0x0003F7FF
	---help---
		"End address of SAU region 3."

choice
	prompt "Region 3 secure configuration"
	depends on SAU_INIT_REGION3
	default REGION3_SECURE

config REGION3_NONSECURE
	bool "Region 3 non-secure"
	---help---
		Region 3 is non-secure.

config REGION3_SECURE
	bool "Region 3 secure"
	---help---
		Region 3 is secure.
endchoice

config SAU_INIT_REGION4
	bool "Setup SAU Region 4"
	default y
	---help---
		Setup SAU Region 4.

config SAU_INIT_START4
	hex "Start address of SAU region 4"
	depends on SAU_INIT_REGION4
	default	0x10040000
	---help---
		"Start address of SAU region 4."

config SAU_INIT_END4
	hex "End address of SAU region 4"
	depends on SAU_INIT_REGION4
	default	0x1007FFFF
	---help---
		"End address of SAU region 4."

choice
	prompt "Region 4 secure configuration"
	depends on SAU_INIT_REGION4
	default REGION4_NONSECURE

config REGION4_NONSECURE
	bool "Region 4 non-secure"
	---help---
		Region 4 is non-secure.

config REGION4_SECURE
	bool "Region 4 secure"
	---help---
		Region 4 is secure.
endchoice

config SAU_INIT_REGION5
	bool "Setup SAU Region 5"
	default y
	---help---
		Setup SAU Region 5.

config SAU_INIT_START5
	hex "Start address of SAU region 5"
	depends on SAU_INIT_REGION5
	default	0x00807E00
	---help---
		"Start address of SAU region 5."

config SAU_INIT_END5
	hex "End address of SAU region 5"
	depends on SAU_INIT_REGION5
	default	0x00807FFF
	---help---
		"End address of SAU region 5."

choice
	prompt "Region 5 secure configuration"
	depends on SAU_INIT_REGION5
	default REGION5_SECURE

config REGION5_NONSECURE
	bool "Region 5 non-secure"
	---help---
		Region 5 is non-secure.

config REGION5_SECURE
	bool "Region 5 secure"
	---help---
		Region 5 is secure.
endchoice

config SAU_INIT_REGION6
	bool "Setup SAU Region 6"
	default y
	---help---
		Setup SAU Region 6.

config SAU_INIT_START6
	hex "Start address of SAU region 6"
	depends on SAU_INIT_REGION6
	default	0x30008000
	---help---
		"Start address of SAU region 6."

config SAU_INIT_END6
	hex "End address of SAU region 6"
	depends on SAU_INIT_REGION6
	default	0x30017FFF
	---help---
		"End address of SAU region 6."

choice
	prompt "Region 6 secure configuration"
	depends on SAU_INIT_REGION6
	default REGION6_NONSECURE

config REGION6_NONSECURE
	bool "Region 6 non-secure"
	---help---
		Region 6 is non-secure.

config REGION6_SECURE
	bool "Region 6 secure"
	---help---
		Region 6 is secure.
endchoice

config SAU_INIT_REGION7
	bool "Setup SAU Region 7"
	default y
	---help---
		Setup SAU Region 7.

config SAU_INIT_START7
	hex "Start address of SAU region 7"
	depends on SAU_INIT_REGION7
	default	0x50000000
	---help---
		"Start address of SAU region 7."

config SAU_INIT_END7
	hex "End address of SAU region 7"
	depends on SAU_INIT_REGION7
	default	0x5FFFFFFF
	---help---
		"End address of SAU region 7."

choice
	prompt "Region 7 secure configuration"
	depends on SAU_INIT_REGION7
	default REGION7_NONSECURE

config REGION7_NONSECURE
	bool "Region 7 non-secure"
	---help---
		Region 7 is non-secure.

config REGION7_SECURE
	bool "Region 7 secure"
	---help---
		Region 7 is secure.
endchoice

endmenu # Enable and Set Secure/Non-Secure region

endmenu # Secure Attribution Configuration
```
