## Kconfig
```kconfig
#
# For a description of the syntax of this configuration file,
# see the file kconfig-language.txt in the docs folder of mTower repository.
#

mainmenu "mTower/$ARCH Configuration"

menu "Build Setup"

choice
	prompt "Control Optimization Options"
	default OPTIMIZATION_LEVEL_O1

config OPTIMIZATION_LEVEL_OS
	bool "Optimization level -Os  (not supported yet)"
	---help---
		"The optimization level -Os (not supported yet - internal compiler
		error: Segmentation fault)"

config OPTIMIZATION_LEVEL_O1
	bool "Optimization level -O1"
	---help---
		The optimization level -O1

config OPTIMIZATION_LEVEL_O2
	bool "Optimization level -O2 (not supported yet)"
	---help---
		"The optimization level -O2 (not supported yet - internal compiler
		error: Segmentation fault)"

config OPTIMIZATION_LEVEL_O3
	bool "Optimization level -O3 (not supported yet)"
	---help---
		"The optimization level -O3 (not supported yet - internal compiler
		error: Segmentation fault)"
endchoice

config OPTIMIZATION_LEVEL
	string
	default "-Os"    if OPTIMIZATION_LEVEL_OS
	default "-O1"    if OPTIMIZATION_LEVEL_O1
	default "-O2"    if OPTIMIZATION_LEVEL_O2
	default "-O3"    if OPTIMIZATION_LEVEL_O3

menu "Debug Options"

config DEBUG_ALERT
	bool
	default n

config DEBUG_FEATURES
	bool "Enable Debug Features"
	default n
	select DEBUG_ALERT
	---help---
		Enables built-in debug features.  Selecting this option will (1) Enable
		debug assertions in the code, (2) enable extended parameter testing in
		many functions, and (3) enable support for debug output to the SYSLOG.
		Note that enabling this option by itself does not produce debug output.
		Debug output must also be selected on a subsystem-by-subsystem basis.

if DEBUG_FEATURES

comment "Debug mTower LOG Output Controls"

config DEBUG_ERROR
	bool "Enable Error Output"
	default n
	---help---
		Enables output from [subsystem]err() statements.  Errors are significant
		system exceptions that require immediate attention.

config DEBUG_WARN
	bool "Enable Warnings Output"
	default n
	depends on DEBUG_ERROR
	---help---
		Enables output from [subsystem-z]warn() statements.  Warnings are
		considered to be various unexpected conditions, potential errors or
		errors that will not have serious consequences.

config DEBUG_INFO
	bool "Enable Informational Debug Output"
	default n
	depends on DEBUG_WARN
	---help---
		Enables verbose "informational" debug output.  If you enable
		CONFIG_DEBUG_INFO, then very chatty (and often annoying) output
		will be generated.

config DEBUG_DBG
	bool "Enable Debug Informational Output"
	default n
	depends on DEBUG_INFO
	---help---
		Enables verbose "debug" output.  If you enable
		CONFIG_DEBUG_DBG, then very chatty (and often annoying) output
		will be generated.

config DEBUG_ASSERTIONS
	bool "Enable Debug Assertions"
	default n
	---help---
		Enables the DEBUGASSERT() macro.  When CONFIG_DEBUG_ASSERTIONS is
		defined, DEBUGASSERT() will cause the system to halt if the
		assertion fails.  If CONFIG_DEBUG_ASSERTIONS is not defined
		DEBUGASSERT() compiled out of the system.  In general, you would
		set CONFIG_DEBUG_ASSERTIONS=y during debug, but disable the
		assertions on a final, buckled up system.

config DEBUG_INCLUDE_FILE_FUNCTION_NAME
	bool "Enable include File and Function name to output"
	default n
	---help---
		Enables include file and function name to debug messages.

config DEBUG_COLORIZED_OUTPUT
	bool "Enable colorized output"
	default n
	---help---
		Enables colorize debug messages.

comment "Subsystem Debug Options"

endif # DEBUG_FEATURES

config DEBUG_SYMBOLS
	bool "Generate Debug Symbols"
	default n
	---help---
		Build with debug symbols (needed for use with a debugger).

comment "GP TEE API Debug Options"

choice
	prompt "TEE Internal API trace level"
	default TRACE_LEVEL_INFO

config TRACE_LEVEL_MSG
	bool "MSG"
	---help---
		"Formatted trace tagged with level independent"

config TRACE_LEVEL_ERROR
	bool "MSG ERROR"
	---help---
		"Formatted trace tagged with TRACE_ERROR level"

config TRACE_LEVEL_INFO
	bool "MSG + ERROR + INFO"
	---help---
		"Formatted trace tagged with TRACE_INFO level"

config TRACE_LEVEL_DEBUG
	bool "MSG + ERROR + INFO + DEBUG"
	---help---
		"Formatted trace tagged with TRACE_DEBUG level"

config TRACE_LEVEL_FLOW
	bool "MSG + ERROR + INFO + DEBUG + FLOW"
	---help---
		"Formatted trace tagged with TRACE_FLOW level"

endchoice

config TRACE_LEVEL
	int
	default 0    if TRACE_LEVEL_MSG
	default 1    if TRACE_LEVEL_ERROR
	default 2    if TRACE_LEVEL_INFO
	default 3    if TRACE_LEVEL_DEBUG
	default 4    if TRACE_LEVEL_FLOW

choice
	prompt "TEE Client API trace level"
	default DEBUGLEVEL_INFO

config DEBUGLEVEL_ERROR
	bool "ERROR"
	---help---
		"Formatted trace tagged with TRACE_ERROR level"

config DEBUGLEVEL_INFO
	bool "ERROR + INFO"
	---help---
		"Formatted trace tagged with TRACE_INFO level"

config DEBUGLEVEL_DEBUG
	bool "ERROR + INFO + DEBUG"
	---help---
		"Formatted trace tagged with TRACE_DEBUG level"

config DEBUGLEVEL_FLOW
	bool "ERROR + INFO + DEBUG + FLOW"
	---help---
		"Formatted trace tagged with TRACE_FLOW level"

endchoice

config DEBUGLEVEL
	int
	default 1    if DEBUGLEVEL_ERROR
	default 2    if DEBUGLEVEL_INFO
	default 3    if DEBUGLEVEL_DEBUG
	default 4    if DEBUGLEVEL_FLOW

endmenu # Debug Options

endmenu # Build Setup

menu "Trusted boot"

config BOOTLOADER1
	bool "Enable BL1 (not supported yet)"
	default n
	---help---
		"Boot Loader1 is enabled"

config BOOTLOADER2
	bool "Enable BL2"
	default y
	---help---
		"BootLoader2 is enabled"

config BOOTLOADER32
	bool "Enable BL32 (Secure handler)"
	default y
	---help---
		"BootLoader32 is enabled (Secure handler)"

config BOOTLOADER33
	bool "Enable BL33 (FreeRTOS)"
	depends on BOOTLOADER32
	default y
	---help---
		"BootLoader33 is enabled (FreeRTOS)"

config START_ADDRESS_BL32
	hex
	depends on BOOTLOADER32
	default 0x00000000 if !BOOTLOADER2
	default 0x00010000 if BOOTLOADER2

config START_ADDRESS_BL33
	hex	"Start address BL33"
	depends on BOOTLOADER33
	default 0x10040000
	range 0x10000000 0x10080000
	---help---
		"Start address of BL33"

endmenu

menu "System Type"
source "arch/Kconfig"
endmenu

menu "Standard Libc Configuration"
source "common/Kconfig"
endmenu

menu "GP TEE Configuration"

config MAX_CRYPTO_CHUNK_SIZE
	hex "Maximum crypto chunk size (hex)"
	default 0x400
	default 0x00010000 if BOOTLOADER2
	---help---
		"Maximum chunk size for TEE crypto operations. Keep in mind that this is the heap size..."
endmenu

menu "Application Configuration"
source "apps/Kconfig"
endmenu
```

## apps/Kconfig
```kconfig
#
# For a description of the syntax of this configuration file,
# see the file kconfig-language.txt in the docs folder of mTower repository.
#

comment "Pseudo TAs:"

config APPS_HELLO_WORLD
	bool "Hello world example"
	default y
	---help---
		"Hello world example."

comment "User TAs:"

config APPS_AES
	bool "AES example"
	default y
	---help---
		"AES example."

config APPS_HOTP
	bool "HOTP example"
	default y
	---help---
		"HOTP example. HMAC based One Time Passwords or shortly just 'HOTP' has
		been around for many years and was initially defined in [RFC4226]."

comment "Test suite:"

config APPS_TEST
	bool "GP API test suite"
	default n
	---help---
		"GP TEE Client API and TEE Internal API test suite."

comment "H/W Security exception:"

config APPS_HW_SECURITY_EXCEPTION_EXAMPLE
	bool "H/W security exception example"
	default n
	---help---
		"H/W security exception example."

config APPS_SPY
	bool "Spy app example"
	default n
	---help---
		"Spy application example"
```

## arch/Kconfig
```kconfig
#
# For a description of the syntax of this configuration file,
# see the file kconfig-language.txt in the docs folder of mTower repository.
#

choice
	prompt "MCU Architecture"
	default ARCH_CORTEX_M23

config ARCH_CORTEX_M23
	bool "cortex-m23"
	---help---
		The ARM architecture

config ARCH_CORTEX_M33
	bool "cortex-m33"
	---help---
		The ARM architecture

endchoice

config ARCH
	string
	default "cortex-m23"    if ARCH_CORTEX_M23
	default "cortex-m33"    if ARCH_CORTEX_M33

if ARCH_CORTEX_M23
source arch/cortex-m23/Kconfig
endif

if ARCH_CORTEX_M33
source arch/cortex-m33/Kconfig
endif

comment "Toolchain Configuration Options"
choice
	prompt "Toolchain Selection"
	default	GCC_VERSION_6_1_2017Q1

config GCC_VERSION_6_1_2017Q1
	# depends on ARCH_FAMILY_MPS2
	bool "GCC compiler Version: 6.1 q1"

config GCC_VERSION_6_1_2017Q2
	# depends on ARCH_FAMILY_MPS2
	bool "GCC compiler Version: 6.1 q2"

config GCC_VERSION_8_2018Q4
	# depends on ARCH_FAMILY_MPS2
	bool "GCC compiler Version: 8 q4"

# config GCC_VERSION_8_2019Q3
# 	depends on ARCH_FAMILY_MPS2
# 	bool "GCC compiler Version: 8 2019 q3"

endchoice

config GCC_VERSION
	string
	default arm-none-eabi-6-2017-q1-update-linux   if GCC_VERSION_6_1_2017Q1
	default arm-none-eabi-6-2017-q2-update-linux   if GCC_VERSION_6_1_2017Q2
	default arm-none-eabi-8-2018-q4-major-linux    if GCC_VERSION_8_2018Q4
	# default gcc-arm-none-eabi-8-2019-q3-update-linux   if GCC_VERSION_8_2019Q3

config GCC_SITE
	string
	default "https://developer.arm.com/-/media/Files/downloads/gnu-rm/6_1-2017q1"   if GCC_VERSION_6_1_2017Q1
	default "https://armkeil.blob.core.windows.net/developer/Files/downloads/gnu-rm/6-2017q2"   if GCC_VERSION_6_1_2017Q2
	default "https://developer.arm.com/-/media/Files/downloads/gnu-rm/8-2018q4" if GCC_VERSION_8_2018Q4
	# default "https://developer.arm.com/-/media/Files/downloads/gnu-rm/8-2019q3" if GCC_VERSION_8_2019Q3
	# default "https://developer.arm.com/-/media/Files/downloads/gnu-rm/8-2019q3/RC1.1" if GCC_VERSION_8_2019Q3
	# https://developer.arm.com/-/media/Files/downloads/gnu-rm/8-2019q3/RC1.1/gcc-arm-none-eabi-8-2019-q3-update-linux.tar.bz2?revision=c34d758a-be0c-476e-a2de-af8c6e16a8a2?product=GNU%20Arm%20Embedded%20Toolchain%20Downloads,64-bit,,Linux,8-2019-q3-update

config GCC_FOLDER
	string
	default "gcc-arm-none-eabi-6-2017-q1-update"   if GCC_VERSION_6_1_2017Q1
	default "gcc-arm-none-eabi-6-2017-q2-update"   if GCC_VERSION_6_1_2017Q2
	default "gcc-arm-none-eabi-8-2018-q4-major"    if GCC_VERSION_8_2018Q4
	# default "gcc-arm-none-eabi-8-2019-q3-update"   if GCC_VERSION_8_2019Q3
```

## arch/cortex-m23/Kconfig
```kconfig
#
# For a description of the syntax of this configuration file,
# see the file kconfig-language.txt in the docs folder of mTower repository.
#

choice
	prompt "MCU Family"
	default M2351

config ARCH_FAMILY_M2351
	bool "M2351"
	---help---
		The M2351 architecture

endchoice

config ARCH_FAMILY
	string
	default "m2351"            if ARCH_FAMILY_M2351

if ARCH_FAMILY_M2351
comment "M2351 Configuration Options"
source arch/cortex-m23/m2351/Kconfig
endif

comment "Toolchain Configuration Options"
choice
	prompt "Toolchain Selection"
	default	GCC_VERSION_6_1_2017Q1

config GCC_VERSION_6_1_2017Q1
	depends on ARCH_FAMILY_M2351 
	bool "GCC compiler Version: 6.1 q1"

config GCC_VERSION_6_1_2017Q2
	depends on ARCH_FAMILY_M2351 
	bool "GCC compiler Version: 6.1 q2"

config GCC_VERSION_8_2018Q4
	depends on ARCH_FAMILY_M2351 
	bool "GCC compiler Version: 8 q4"

endchoice

config GCC_VERSION
	string
	default arm-none-eabi-6-2017-q1-update-linux   if GCC_VERSION_6_1_2017Q1
	default arm-none-eabi-6-2017-q2-update-linux   if GCC_VERSION_6_1_2017Q2
	default arm-none-eabi-8-2018-q4-major-linux    if GCC_VERSION_8_2018Q4

config GCC_SITE
	string
	default "https://developer.arm.com/-/media/Files/downloads/gnu-rm/6_1-2017q1"   if GCC_VERSION_6_1_2017Q1
	default "https://armkeil.blob.core.windows.net/developer/Files/downloads/gnu-rm/6-2017q2"   if GCC_VERSION_6_1_2017Q2
	default "https://developer.arm.com/-/media/Files/downloads/gnu-rm/8-2018q4" if GCC_VERSION_8_2018Q4
	

config GCC_FOLDER 
	string
	default "gcc-arm-none-eabi-6-2017-q1-update"   if GCC_VERSION_6_1_2017Q1
	default "gcc-arm-none-eabi-6-2017-q2-update"   if GCC_VERSION_6_1_2017Q2
	default "gcc-arm-none-eabi-8-2018-q4-major"    if GCC_VERSION_8_2018Q4
```
